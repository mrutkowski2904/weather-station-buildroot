## Config.in
```kconfig
# Name set in external.desc
source "$BR2_EXTERNAL_WEATHER_STATION_PATH/package/lps25hb/Config.in"
source "$BR2_EXTERNAL_WEATHER_STATION_PATH/package/ssd1306/Config.in"
source "$BR2_EXTERNAL_WEATHER_STATION_PATH/package/web_server/Config.in"
source "$BR2_EXTERNAL_WEATHER_STATION_PATH/package/display_app/Config.in"
```

## package/display_app/Config.in
```kconfig
config BR2_PACKAGE_DISPLAY_APP
        bool "display_app"
        help
                Application that manages weather station's display
```

## package/lps25hb/Config.in
```kconfig
config BR2_PACKAGE_LPS25HB_MODULE
        bool "lps25hb"
        depends on BR2_LINUX_KERNEL
        help
                Custom driver for LPS25HB barometer
```

## package/mcp23008/Config.in
```kconfig
config BR2_PACKAGE_MCP23008_MODULE
        bool "mcp23008"
        depends on BR2_LINUX_KERNEL
        help
                Custom driver for MCP23008 GPIO expander
```

## package/ssd1306/Config.in
```kconfig
config BR2_PACKAGE_SSD1306_MODULE
        bool "ssd1306"
        depends on BR2_LINUX_KERNEL
        help
                Custom framebuffer driver for SSD1306 display
```

## package/ui_app/Config.in
```kconfig
config BR2_PACKAGE_UI_APP
        bool "ui_app"
        depends on BR2_PACKAGE_LIBGPIOD
        help
                Application that manages weather station's ui
```

## package/web_server/Config.in
```kconfig
config BR2_PACKAGE_WEB_SERVER
        bool "web_server"
        depends on BR2_INSTALL_LIBSTDCPP
        help
                Custom web server implementation
```
